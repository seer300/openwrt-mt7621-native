## package/ramips/drivers/mt7628sta/config.in
```kconfig
if PACKAGE_kmod-mt7628sta

config MT7628_RT_FIRST_CARD
	int
	default 7628

config MT7628_MT_WIFI
	bool
	select WIFI_BASIC_FUNC
	default y

config MT7628_MT_WIFI_PATH
	string
	depends on MT7628_MT_WIFI
	default "rlt_wifi"

config MT_WIFI
	tristate #"MT WIFI Driver"
	select WIFI_BASIC_FUNC if MT_WIFI
	default y

#config MT_WIFI_PATH
#	string
#	depends on MT_WIFI
#	default "rlt_wifi"

if MT_WIFI
menu "WiFi Generic Feature Options"

config FIRST_IF_EEPROM_FLASH
	bool
	default y

config RT_FIRST_CARD_EEPROM
	string
	default "flash"

config SECOND_IF_EEPROM_FLASH
	bool
	default y

config RT_SECOND_CARD_EEPROM
	string
	default "flash"
		
config MULTI_INF_SUPPORT
	bool
	#default y if !FIRST_IF_NONE && !SECOND_IF_NONE
	default n

config WIFI_BASIC_FUNC
	bool "Basic Functions"
	select WIRELESS_EXT
	select WEXT_SPY
	select WEXT_PRIV

config MT7628_WSC_INCLUDED
	bool "WSC (WiFi Simple Config)"
	depends on MT7628_AP_SUPPORT
	default y

config MT7628_WSC_V2_SUPPORT
	bool "WSC V2(WiFi Simple Config Version 2.0)"
	depends on MT7628_AP_SUPPORT
	default y

config MT7628_DOT11W_PMF_SUPPORT
	bool "PMF"
	depends on MT7628_AP_SUPPORT
	default y

config MT7628_LLTD_SUPPORT
	bool "LLTD (Link Layer Topology Discovery Protocol)"
	depends on MT7628_AP_SUPPORT
	default n

config MT7628_QOS_DLS_SUPPORT
	bool "802.11e DLS ((Direct-Link Setup) Support"
	depends on MT7628_AP_SUPPORT
	default n

#config MT7628_WAPI_SUPPORT
#	bool "WAPI Support"
##	default n

#config MT7628_FTM_SUPPORT
#	bool "FTM Support"
##	default n

config MT7628_IGMP_SNOOP_SUPPORT
	bool "IGMP snooping"
	depends on MT7628_AP_SUPPORT
	default n

config MT7628_BLOCK_NET_IF
	bool "NETIF Block"
	depends on MT7628_AP_SUPPORT
	default n
	help
	Support Net interface block while Tx-Sw queue full

config MT7628_RATE_ADAPTION
	bool "New Rate Adaptation support"
	default y

config MT7628_NEW_RATE_ADAPT_SUPPORT
	bool "Intelligent Rate Adaption"
	depends on MT7628_RATE_ADAPTION
	default y

config MT7628_AGS_SUPPORT
	bool "Adaptive Group Switching"
	depends on MT7628_RATE_ADAPTION
	depends on MT7628_AP_SUPPORT
	default n

config MT7628_IDS_SUPPORT
	bool "IDS (Intrusion Detection System) Support"
	depends on MT7628_AP_SUPPORT
	default n

config MT7628_WIFI_WORK_QUEUE
	bool "Work Queue"
	default n

config MT7628_WIFI_SKB_RECYCLE
	bool "SKB Recycle(Linux)"
	depends on MT7628_AP_SUPPORT
	default n

config MT7628_SMART_CARRIER_SENSE_SUPPORT
	bool "Smart Carrier Sense"
	default y

config MT7628_LED_CONTROL_SUPPORT
	bool "LED Support"
	depends on MT7628_AP_SUPPORT
	default n

config MT7628_ATE_SUPPORT
	bool "ATE/QA Support"
	depends on MT7628_AP_SUPPORT
	default n

config MT7628_MEMORY_OPTIMIZATION
	bool "Memory Optimization"
	default n

config MT7628_PASSPOINT_R2
	bool "Passpoint Release-2 Support"
	select MT7628_DOT11W_PMF_SUPPORT
	depends on MT7628_AP_SUPPORT
	default n

#config MT7628_TRACE_IPARP
#	bool "IP/ARP trace log"
#
config MT7628_SINGLE_SKU
	bool "Single SKU Support"
	depends on MT7628_AP_SUPPORT
	default n

config MT7628_UAPSD
	bool "UAPSD support"
	depends on MT7628_AP_SUPPORT
	default y

#
# Section for chip architectures
#
# "MT MAC Support"
config MT_MAC
	bool
	default y

# "RLT MAC Support"
#config RLT_MAC
#	bool
##	default n

#config RLT_BBP
#	bool

#config RLT_RF
#	bool

# "RTMP MAC Support"
#config RTMP_MAC
#	bool
##	default n

#config RTMP_BBP
#		bool

#config RTMP_RF
#		bool

#
# Section for interfaces
#
config RTMP_PCI_SUPPORT
	bool

config RTMP_USB_SUPPORT
	bool

config RTMP_RBUS_SUPPORT
	bool

endmenu

menu "WiFi Operation Modes"
	choice
		prompt "Main Mode"
		default MT_WIFI_MODE_STA

		config MT_WIFI_MODE_AP
			bool "AP"
			select MT_AP_SUPPORT

		config MT_WIFI_MODE_STA
			bool "STA"
			select MT_STA_SUPPORT

		config MT_WIFI_MODE_BOTH
			bool "APSTA"
			select MT_AP_SUPPORT
			select MT_STA_SUPPORT

	endchoice

	config MT_STA_SUPPORT
		tristate "Mediatek 802.11n STA support"
		select WIRELESS_EXT
		select WEXT_SPY
		select WEXT_PRIV
		default y

config MT_AP_SUPPORT
	bool

endmenu

endif

endif
```
